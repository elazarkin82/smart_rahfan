## yocto/build/conf/local.conf
```bitbake
MACHINE = "radxa-zero-3e"
DISTRO ?= "poky"
PACKAGE_CLASSES = "package_ipk"
CONF_VERSION = "2"

DL_DIR = "${TOPDIR}/../downloads"
SSTATE_DIR = "${TOPDIR}/../sstate-cache"

INIT_MANAGER = "systemd"

EXTRA_IMAGE_FEATURES += "ssh-server-openssh"

MACHINE_ESSENTIAL_EXTRA_RRECOMMENDS += "kernel-modules"

IMAGE_FSTYPES += "wic wic.bmap"

IMAGE_INSTALL:append = " \
    v4l-utils \
    static-ip \
    libjpeg-turbo \
    libturbojpeg \
"

IMAGE_INSTALL:append = " rockchip-librga"

PREFERRED_PROVIDER_virtual/kernel:radxa-zero-3e = "linux-rockchip"
PREFERRED_PROVIDER_virtual/kernel:radxa-zero-3 = "linux-rockchip"
```

## yocto/meta-ksg/conf/layer.conf
```bitbake
# We have a conf and classes directory, add to BBPATH
BBPATH .= ":${LAYERDIR}"

# We have recipes-* directories, add to BBFILES
BBFILES += "${LAYERDIR}/recipes-*/*/*.bb \
            ${LAYERDIR}/recipes-*/*/*.bbappend"

BBFILE_COLLECTIONS += "meta-ksg"
BBFILE_PATTERN_meta-ksg = "^${LAYERDIR}/"
BBFILE_PRIORITY_meta-ksg = "6"

LAYERDEPENDS_meta-ksg = "core"
LAYERSERIES_COMPAT_meta-ksg = "scarthgap"
```
